    #include "test.dtsi"
    
    &kscan0 {
    	col-gpios
        = <&gpio1 11 GPIO_ACTIVE_HIGH>	//Col0
        , <&gpio1 13 GPIO_ACTIVE_HIGH>  //Col1
    		;
    };
    
    &default_transform { // Offset of 3 because the left side has 3 columns
        col-offset = <7>;
    };
    
    &right_encoder {
      status = "okay";
    };
