## boards/shields/Kconfig.defconfig
```kconfig
if SHIELD_TEST_D

config ZMK_KEYBOARD_NAME
    default "test_d"

config ZMK_SPLIT_BLE_ROLE_CENTRAL
    default y

endif

if SHIELD_TEST_K

config ZMK_KEYBOARD_NAME
    default "test_k"
    
endif

if SHIELD_THUMBROTARY_LEFT || SHIELD_THUMBROTARY_RIGHT

config ZMK_SPLIT
    default y

endif
```

## boards/shields/Kconfig.shield
```kconfig
# Copyright (c) 2020 Pete Johanson
# SPDX-License-Identifier: MIT

config SHIELD_TEST_D
    def_bool $(shields_list_contains,test_d)

config SHIELD_TEST_K
    def_bool $(shields_list_contains,test_k)
```

## boards/shields/test/Kconfig.shield
```kconfig
# Copyright (c) 2020 Pete Johanson
# SPDX-License-Identifier: MIT

config SHIELD_TEST
    def_bool $(shields_list_contains,test)
```
